## drivers/input/fingerprint/goodix_ta/Kconfig
```kconfig
config FINGERPRINT_GOODIX_TA
	tristate "Finger print card goodix"
	depends on INPUT_FINGERPRINT
	default y
	help
	  Say Y here to enable support for retrieving self-test reports.

	  If unsure, say N.

	  To compile this driver as a module, choose M here.
```
